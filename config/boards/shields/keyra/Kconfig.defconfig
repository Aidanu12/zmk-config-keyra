## config/boards/shields/keyra/Kconfig.defconfig
```kconfig
if SHIELD_KEYRA_LEFT

config ZMK_KEYBOARD_NAME
    default "Keyra"

config ZMK_SPLIT_ROLE_CENTRAL
    default y

endif

if SHIELD_KEYRA_LEFT || SHIELD_KEYRA_RIGHT

config ZMK_SPLIT
    default y

endif
```

## config/boards/shields/keyra/Kconfig.shield
```kconfig
config SHIELD_KEYRA_LEFT
    def_bool $(shields_list_contains,keyra_left)

config SHIELD_KEYRA_RIGHT
    def_bool $(shields_list_contains,keyra_right)
```
